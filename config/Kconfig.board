## config/Kconfig.board
```kconfig
#include <dt-bindings/zmk/bt.h>

//Holyiot 18010 board configuration
//Copyright (c) 2025 The ZMK Contributors
//SPDX-License-Identifier: MIT
//HOLYIOT 18010 board configuration

config BOARD_HOLYIOT_18010
	bool "holyiot_18010"
	depends on SOC_NRF52840_QIAACO

config BOARD_ENABLE_DCDC
	bool "Enable DCDC mode"
	select SOC_DCDC_NRF52X
	default y
	depends on BOARD_HOLYIOT_18010

config BOARD_HOLYIOT_18010_CHARGER
	bool "Enable battery charger"
	default y
	depends on BOARD_HOLYIOT_18010

CONFIG_BT=y
CONFIG_ZMK_BLE=y
CONFIG_BT_BAS=y
CONFIG_BT_MAX_CONN=5
CONFIG_BT_MAX_PAIRED=5

CONFIG_ZMK_KEYBOARD_NAME="nber08-gamepad"
```
